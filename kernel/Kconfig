## kernel/Kconfig
```kconfig
config VIDEO_SUNXI_CEDAR
	tristate "sunxi video encoder and decoder support"
	default m
	---help---
	  This is the driver for sunxi video decoder, including h264/
	  mpeg4/mpeg2/vc1/rmvb.
	  To compile this driver as a module, choose M here: the
	  module will be called cedar_dev.
```
